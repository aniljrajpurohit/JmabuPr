;EXPT NO._4C: LCD INTERFACING IN 4 BIT MODE FOR DISPLAYING "WELCOME TO VIIT" ROTATING MESSAGE
;NAME - ANIL RAJPUROHIT
;ROLL NO.312046, BATCH -B2
;DATE OF PERFORMANCE - 25/7/18

		ORG 000H
		RS EQU P2.0
		EN EQU P2.1
		RW EQU P2.2
		LCD EQU P0

		MOV A,#28H     ;TO INITIALIZE LCD AS 4 BIT DATA LENGTH, NO.OF LINES 2, 5*7 RESOLUTION
		ACALL COMMAND  ;SEND COMMAND TO LCD
		MOV A,#0EH     ;TURN ON THE DISPLAY AND CURSOR
		ACALL COMMAND  ;SEND COMMAND TO LCD
		MOV A,#01H     ;CLEAR LCD DISPLAY,MEMORY AND CURSOR AT HOME POSITION
		ACALL COMMAND  ;SEND COMMAND TO LCD
		MOV A,#07H     ;TO SHIFT CURSOR TO LEFT FOR NEXT CHARACTER AND DIGIT RIGHT TO LEFT
		ACALL COMMAND  ;SEND COMMAND TO LCD
		MOV A,#8FH     ;SELECT 1ST LINE AND LAST POITION TO DISPLAY AND ROTATE MESSAGE
		ACALL COMMAND  ;SEND COMMAND TO LCD
		MOV A,#80H     ;SELECT 1ST LINE AND POSITION TO DISPLAY MESSAGE
		ACALL COMMAND  ;SEND COMMAND TO LCD

		HERE:MOV A,#'W'     ;SENDING DATA TO LCD
			 ACALL DISPLAY
			 MOV A,#'E'
			 ACALL DISPLAY
			 MOV A,#'L'
			 ACALL DISPLAY
			 MOV A,#'C'
			 ACALL DISPLAY
			 MOV A,#'O'
			 ACALL DISPLAY
			 MOV A,#'M'
			 ACALL DISPLAY
			 MOV A,#'E'
			 ACALL DISPLAY
			 MOV A,#' '
			 ACALL DISPLAY
			 MOV A,#'T'
			 ACALL DISPLAY
			 MOV A,#'O'
			 ACALL DISPLAY
			 MOV A,#' '
			 ACALL DISPLAY
			 MOV A,#'V'
			 ACALL DISPLAY
			 MOV A,#'I'
			 ACALL DISPLAY
			 MOV A,#'I'
			 ACALL DISPLAY
			 MOV A,#'T'
			 ACALL DISPLAY
			 SJMP HERE      ;LOOPING FOR CONTINUOUS OPERATION

		COMMAND:            ;COMMAND SUBROUTINE
			 ACALL DELAY
			 MOV R0,A       ;COPY COMMAND INSTRUCTION FROM ACC TO R0
			 ANL A,#0F0H    ;MASK LOWER NIBBLE
			 SWAP A         ;SWAP THE HIGHER NIBBLE TO LSB SIDE AS LOWER PORT PINS ARE CONNECTED
			 MOV P0,A       ;MOVE COMMAND TO LCD THROUGH PORT
			 CLR RS         ;SELECTING COMMAND REGISTER FOR COMMMAND
			 CLR RW         ;SELECTING WRITING MODE
			 SETB EN        ;FOR WRITE GIVE HIGH TO LOW PULSE
			 NOP			;WAIT FOR TWO MACHINE CYCLES
			 NOP
			 CLR EN
			 MOV A,R0       ;TAKE ORIGINAL COMMAND FROM PORT R0
			 ANL A,#0FH     ;MASK HIGHER NIBBLE
			 MOV P0,A       ;MOVE COMMAND TO LCD THROUGH PORT
			 CLR RS         ;SELECTING COMMAND REGISTER FOR COMMAND
			 CLR RW         ;SELECTING WRITING MODE
			 SETB EN        ;FOR WRITE GIVE HIGH TO LOW PULSE
			 NOP			;WAIT FOR TWO MACHINE CYCLES
			 NOP
			 CLR EN
			 RET

		DISPLAY:
			 ACALL DELAY    ;DELAY CALL
			 MOV R0,A       ;COPY COMMAND INSTRUCTION FROM ACC TO R0
			 ANL A,#0F0H    ;MASK LOWER NIBBLE
			 SWAP A         ;SWAP THE HIGHER NIBBLE TO LSB SIDE
			 MOV P0,A       ;MOVE COMMAND TO LCD THROUGH PORT
			 SETB RS        ;SELECTING DATA REGISTER FOR COMMAND
			 CLR RW         ;SELECTING WRITING MODE
			 SETB EN        ;FOR WRITE GIVE HIFH TO LOW PULSE
			 NOP			;WAIT FOR TWO MACHINE CYCLES
			 NOP
			 CLR EN
			 MOV A,R0       ;TAKE ORIGINAL COMMAND FROM R0
			 ANL A,#0FH     ;MASK HIGHER NIBBLE
			 MOV P0,A       ;MOVE COMMAND TO LCD THROUGH PORT
			 SETB RS        ;SELECTING DATA REGISTER FOR COMMAND
			 CLR RW         ;SELECTING WRITING MODE
			 SETB EN        ;FOR WRITE GIVE HIGH TO LOW PULSE
			 NOP			;WAIT FOR TWO MACHINE CYCLES
			 NOP
			 CLR EN
			 RET

		DELAY:             	;DELAY SUBROUTINE
			MOV TMOD,#01H
			MOV TH0,#0F8H
			MOV TL0,#0CCH
			SETB TR0
		L3:	JNB TF0,L3
			CLR TR0
			CLR TF0
			RET
			
		   END