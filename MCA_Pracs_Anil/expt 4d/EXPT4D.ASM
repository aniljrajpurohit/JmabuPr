;EXPT NO_4D: ALP FOR LCD INTERFACING USING MOVC INSTRUCTION IN 8 BIT MODE FOR DISPLAYING "WELCOME TO ENTC"
;USING TIME DELAY ON LINE 1
;NAME - ANIL RAJPUROHIT
;ROLL NO.312046
;BATCH - B2
;DATE OF PERFORMANCE - 25/7/18

			ORG 0000H
			RS EQU P2.0
			EN EQU P2.1
			RW EQU P2.2
			LCD EQU P0

			MOV A,#38H    ;TO INITIALIZE LCD AS 8 BIT,5*7 RESOLUTION, 2LINE
			ACALL COMMAND ;CALL THE COMMAND SUBROUTINE

			MOV A,#0EH    ;TURN ON THE DISPLAY AND CURSOR
			ACALL COMMAND ;CALL THE COMMAND SUBROUTINE

			MOV A,#01H    ;CLEAR LCD DISPLAY,MEMORY AND CURSOR AT HOME POSITION
			ACALL COMMAND ;CALL THE COMMAND SUBROUTINE

			MOV A,#06H    ;TO SHIFT CURSOR TO LEFT FOR NEXT HARACTER AND ENABLE  DISABLE
			ACALL COMMAND ;CALL THE COMMAND SUBROUTINE

			MOV A,#80H    ;SELECT 1ST LINE AND POSITION TO DISPLAY MESSAGE
			ACALL COMMAND ;CALL THE COMMAND SUBROUTINE

			MOV DPTR,#STRING
			MOV R2,#00H   ;INITIALIZE REGISTER R2 TO 00H

	L1:
			CLR A           ; CLR THE ACCUMALATOR
			MOVC A,@A+DPTR  ; MOVE CONTENTS OF DPTR INTO ACC
			ACALL DISPLAY   ; CALL DISPLAY SUBROUTINE
			INC DPTR        ; INC THE DPTR
			INC R2          ;INC VALUR IN R2
			CJNE R2,#0FH,L1 ; COMPARE JUMP IF NOT EQUAL

COMMAND:       		  	   ;SUBROUTINE TO COMMND INSTRUCTION TO LCD
			ACALL DELAY    ;DELAY CALL
			MOV P0,A       ;MOVE COMMAND TO LCD THROUGH PORT
			CLR RS         ;SELECTING COMMAND REGISTER FOR COMMAND
			CLR RW         ;SELECTING WRITING MODE
			SETB EN        ;FOR WRITE GIVE HIGH TO LOW PULSE
			NOP			   ;WAIT FOR TWO MACHINE CYCLES
			NOP
			CLR EN		   ;CLR EN PIN
			RET

DISPLAY:      			   ;SUBROUTINE TO DISPLAY INSTRUCTION TO LCD
			ACALL DELAY    ;DELAY CALL
			MOV P0,A       ;MOVE DATA TO LCD THROUGH PORT
			SETB RS        ;SELECTING DATA REGISTER FOR COMMAND
			CLR RW         ;SELECTING WRITING MODE
			SETB EN        ;FOR WRITE GIVE HIGH TO LOW PULDE
			NOP			   ;WAIT FOR TWO MACHINE CYCLES
			NOP
			CLR EN         ;CLR EN PIN
			RET

 DELAY:
			MOV TMOD,#01H  ;TIMER 0,MODE 1
		    MOV TH0,#0F8H  ;LOAD HIGH BYTE 
    	    MOV TL0,#0CCH  ;LOAD LOW BYTE
		    SETB TR0       ;START TIMER
	L3:	    JNB TF0,L3     ;MONITOR FLAG UNTILL IT ROLL OVER
		    CLR TR0        ;STOP TIMER
	        CLR TF0        ;CLEAR FLAG
		    RET
			   END
			   
			ORG 3000H
 STRING: 	DB "WELCOME TO ENTC"	   
			   END